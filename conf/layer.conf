## conf/layer.conf
```bitbake
# We have a conf and classes directory, add to BBPATH
BBPATH .= ":${LAYERDIR}"

# We have recipes-* directories, add to BBFILES
BBFILES += "${LAYERDIR}/recipes-*/*.bb \
            ${LAYERDIR}/recipes-*/*.bbappend"

BBFILE_COLLECTIONS += "meta-sniffer"
BBFILE_PATTERN_meta-sniffer = "^${LAYERDIR}/"
BBFILE_PRIORITY_meta-sniffer = "6"

LAYERDEPENDS_meta-sniffer = "core"
LAYERSERIES_COMPAT_meta-sniffer = "scarthgap"
```
